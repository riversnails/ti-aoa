/**
 * @cliArgs --board "/ti/boards/LPSTK_CC1352R" --product "simplelink_cc13x2_26x2_sdk@5.20.00.52"
 * @versions {"data":"2021060817","timestamp":"2021060817","tool":"1.8.2+1992","templates":null}
 */

/**
 * Import the modules used in this configuration.
 */
const CCFG        = scripting.addModule("/ti/devices/CCFG");
const custom      = scripting.addModule("/ti/devices/radioconfig/custom");
const rfdesign    = scripting.addModule("/ti/devices/radioconfig/rfdesign");
const Display     = scripting.addModule("/ti/display/Display");
const Display1    = Display.addInstance();
const AESCCM      = scripting.addModule("/ti/drivers/AESCCM");
const AESCCM1     = AESCCM.addInstance();
const AESCTRDRBG  = scripting.addModule("/ti/drivers/AESCTRDRBG");
const AESCTRDRBG1 = AESCTRDRBG.addInstance();
const AESCTRDRBG2 = AESCTRDRBG.addInstance();
const AESECB      = scripting.addModule("/ti/drivers/AESECB");
const AESECB1     = AESECB.addInstance();
const AESECB2     = AESECB.addInstance();
const ECDH        = scripting.addModule("/ti/drivers/ECDH");
const ECDH1       = ECDH.addInstance();
const GPIO        = scripting.addModule("/ti/drivers/GPIO");
const GPIO1       = GPIO.addInstance();
const GPIO2       = GPIO.addInstance();
const NVS         = scripting.addModule("/ti/drivers/NVS");
const NVS1        = NVS.addInstance();
const RF          = scripting.addModule("/ti/drivers/RF");
const RTOS        = scripting.addModule("/ti/drivers/RTOS");
const TRNG        = scripting.addModule("/ti/drivers/TRNG");
const TRNG1       = TRNG.addInstance();
const TRNG2       = TRNG.addInstance();

/**
 * Write custom configuration values to the imported modules.
 */
CCFG.enableBootloader         = true;
CCFG.enableBootloaderBackdoor = true;
CCFG.dioBootloaderBackdoor    = 13;
CCFG.levelBootloaderBackdoor  = "Active low";
CCFG.ccfgTemplate.$name       = "ti_devices_CCFGTemplate0";

custom.ble                                                    = ["bt5le1m"];
custom.radioConfigbt5le1m.$name                               = "ti_devices_radioconfig_settings_ble0";
custom.radioConfigbt5le1m.paramVisibility                     = false;
custom.radioConfigbt5le1m.codeExportConfig.$name              = "ti_devices_radioconfig_code_export_param0";
custom.radioConfigbt5le1m.codeExportConfig.symGenMethod       = "Custom";
custom.radioConfigbt5le1m.codeExportConfig.rfMode             = "RF_modeBle";
custom.radioConfigbt5le1m.codeExportConfig.txPower            = "RF_BLE_txPowerTable";
custom.radioConfigbt5le1m.codeExportConfig.txPowerSize        = "RF_BLE_TX_POWER_TABLE_SIZE";
custom.radioConfigbt5le1m.codeExportConfig.overrides          = "pOverrides_ble";
custom.radioConfigbt5le1m.codeExportConfig.stackOverride      = "ti/ble5stack/icall/inc/ble_overrides.h";
custom.radioConfigbt5le1m.codeExportConfig.stackOverrideMacro = "BLE_STACK_OVERRIDES";
custom.radioConfigbt5le1m.codeExportConfig.cmdList_ble        = [];

rfdesign.rfDesign = "LPSTK-CC1352R1";

Display1.$name                          = "CONFIG_Display_0";
Display1.$hardware                      = system.deviceData.board.components.XDS110UART;
Display1.enableANSI                     = true;
Display1.uartBufferSize                 = 128;
Display1.uart.$name                     = "CONFIG_DISPLAY_UART";
Display1.uart.txPinInstance.outputState = "High";
Display1.uart.txPinInstance.$name       = "CONFIG_PIN_UART_TX";
Display1.uart.rxPinInstance.$name       = "CONFIG_PIN_UART_RX";
Display1.uart.uart.$assign              = "UART1";
Display1.uart.uart.txPin.$assign        = "boosterpack.4";
Display1.uart.uart.rxPin.$assign        = "boosterpack.3";

AESCCM1.$name = "CONFIG_AESCCM0";

AESCTRDRBG1.$name              = "CONFIG_AESCTRDRBG_0";
AESCTRDRBG1.aesctrObject.$name = "CONFIG_AESCTR_0";

AESCTRDRBG2.$name              = "CONFIG_AESCTRDRBG_1";
AESCTRDRBG2.aesctrObject.$name = "CONFIG_AESCTR_1";

AESECB1.$name = "CONFIG_AESECB0";

AESECB2.$name = "CONFIG_AESECB1";

ECDH1.$name = "CONFIG_ECDH0";

GPIO1.$hardware         = system.deviceData.board.components["BTN-1"];
GPIO1.mode              = "Dynamic";
GPIO1.$name             = "CONFIG_GPIO_BTN1";
GPIO1.pinInstance.$name = "CONFIG_PIN_BTN1";
GPIO1.gpioPin.$assign   = "boosterpack.13";

GPIO2.$hardware         = system.deviceData.board.components["BTN-2"];
GPIO2.mode              = "Dynamic";
GPIO2.$name             = "CONFIG_GPIO_BTN2";
GPIO2.pinInstance.$name = "CONFIG_PIN_BTN2";
GPIO2.gpioPin.$assign   = "boosterpack.12";

NVS1.$name                    = "CONFIG_NVSINTERNAL";
NVS1.internalFlash.$name      = "ti_drivers_nvs_NVSCC26XX0";
NVS1.internalFlash.regionBase = 0x48000;
NVS1.internalFlash.regionSize = 0x4000;

TRNG1.$name = "CONFIG_TRNG_0";

TRNG2.$name = "CONFIG_TRNG_1";
